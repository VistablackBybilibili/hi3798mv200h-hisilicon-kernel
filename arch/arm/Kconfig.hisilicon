## arch/arm/Kconfig.hisilicon
```kconfig
config ARCH_HI3716MV430
	bool "Hisilicon HI3716MV430 family"
	select ARM_AMBA
	select HAVE_CLK
	select CLKDEV_LOOKUP
	select HAVE_SCHED_CLOCK
	select GENERIC_TIME
	select GENERIC_CLOCKEVENTS
	select NEED_MACH_IO_H
	select NEED_MACH_MEMORY_H
	select ARCH_HAS_CPUFREQ
	select HAVE_SMP
	select USB_ARCH_HAS_OHCI
	select USB_ARCH_HAS_EHCI
	select ARM_HAS_SG_CHAIN
	select PM_OPP
	help
	  This enables support for Hisilicon HI3716MV430 platform.
	  With the advanced ARM Cortex A9 processor,
	  HI3716MV430 serial provides high-speed processing capability.
	  And HI3716MV430 serial constains a very powerfull media process engine,
	  two ethernet interface, EHCI and OHCI controllers and
	  many peripheral equipments.

config ARCH_HI3798CV2X
	bool "Hisilicon HI3798CV2X family"
	select ARM_AMBA
	select HAVE_CLK
	select CLKDEV_LOOKUP
	select HAVE_SCHED_CLOCK
	select GENERIC_TIME
	select GENERIC_CLOCKEVENTS
	select ARCH_HAS_CPUFREQ
	select MIGHT_HAVE_PCI
	select HAVE_SMP
	select NEED_MACH_IO_H
	select NEED_MACH_MEMORY_H
	select ARCH_HAS_CPUFREQ
	select USB_ARCH_HAS_OHCI
	select USB_ARCH_HAS_EHCI
	select USB_ARCH_HAS_XHCI
	select ARM_HAS_SG_CHAIN
	select PM_OPP
	help
	  This enables support for Hisilicon HI3798CV2X platform.
	  With the advanced ARM Cortex A17 processor,
	  HI3798CV2X serial provides high-speed processing capability.
	  And HI3798CV2X serial constains a very powerfull media process engine,
	  two ethernet interface, EHCI and OHCI controllers and
	  many peripheral equipments.

config ARCH_HI3798MV2X
	bool "Hisilicon HI3798MV2X family"
	select ARM_AMBA
	select HAVE_CLK
	select CLKDEV_LOOKUP
	select HAVE_SCHED_CLOCK
	select GENERIC_TIME
	select GENERIC_CLOCKEVENTS
	select ARCH_HAS_CPUFREQ
	select MIGHT_HAVE_PCI
	select HAVE_SMP
	select NEED_MACH_IO_H
	select NEED_MACH_MEMORY_H
	select ARCH_HAS_CPUFREQ
	select USB_ARCH_HAS_OHCI
	select USB_ARCH_HAS_EHCI
	select USB_ARCH_HAS_XHCI
	select ARM_HAS_SG_CHAIN
	select PM_OPP
	help
	  This enables support for Hisilicon HI3798MV2X platform.
	  With the advanced ARM Cortex A53 processor,
	  HI3798MV2X serial provides high-speed processing capability.
	  And HI3798MV2X serial constains a very powerfull media process engine,
	  two ethernet interface, EHCI and OHCI controllers and
	  many peripheral equipments.
      
config ARCH_HI3798MV310
	bool "Hisilicon HI3798MV310 family"
	select ARM_AMBA
	select HAVE_CLK
	select CLKDEV_LOOKUP
	select HAVE_SCHED_CLOCK
	select GENERIC_TIME
	select GENERIC_CLOCKEVENTS
	select ARCH_HAS_CPUFREQ
	select MIGHT_HAVE_PCI
	select HAVE_SMP
	select NEED_MACH_IO_H
	select NEED_MACH_MEMORY_H
	select ARCH_HAS_CPUFREQ
	select USB_ARCH_HAS_OHCI
	select USB_ARCH_HAS_EHCI
	select USB_ARCH_HAS_XHCI
	select ARM_HAS_SG_CHAIN
	select PM_OPP
	help
	  This enables support for Hisilicon HI3798MV310 platform.
	  With the advanced ARM Cortex A53 processor,
	  HI3798MV310 serial provides high-speed processing capability.
	  And HI3798MV310 serial constains a very powerfull media process engine,
	  two ethernet interface, EHCI and OHCI controllers and
	  many peripheral equipments.

config ARCH_HI3796MV2X
	bool "Hisilicon HI3796MV2X family"
	select ARM_AMBA
	select HAVE_CLK
	select CLKDEV_LOOKUP
	select HAVE_SCHED_CLOCK
	select GENERIC_TIME
	select GENERIC_CLOCKEVENTS
	select ARCH_HAS_CPUFREQ
	select MIGHT_HAVE_PCI
	select HAVE_SMP
	select NEED_MACH_IO_H
	select NEED_MACH_MEMORY_H
	select ARCH_HAS_CPUFREQ
	select USB_ARCH_HAS_OHCI
	select USB_ARCH_HAS_EHCI
	select USB_ARCH_HAS_XHCI
	select ARM_HAS_SG_CHAIN
	select PM_OPP
	help
	  This enables support for Hisilicon HI3796MV2X platform.
	  With the advanced ARM Cortex A53 processor,
	  HI3798MV2X serial provides high-speed processing capability.
	  And HI3796MV2X serial constains a very powerfull media process engine,
	  two ethernet interface, EHCI and OHCI controllers and
```

## arch/arm/mach-hi3716mv430/Kconfig
```kconfig
if ARCH_HI3716MV430
menu "HI3716MV430 board feature"

config MACH_HI3716MV430
	bool "Support hi3716mv430 platform"
	select CPU_V7
	select ARM_GIC
	select COMMON_CLK
	select ARCH_REQUIRE_GPIOLIB
	select DYNAMIC_DEBUG if !CA_SUPPORT_ADVCA || DEBUG_FS && PRINTK
	help
	  Include support for the hisilion HI3716MV430 platform.
	  HI3716MV430 support ARM CORTEX-A7 processer,
	  within a Generic Interrupt Controller.
	  Support DDR2 and DDR3.

config DEFAULT_UART_BASE_ADDR
	hex "Default uart controller base address"
	default "0xF8B00000"
	help
	  Default UART controller base address

config DEFAULT_VMALLOC_SIZE
	int "Default vmalloc size"
	default 240
	help
	  Default vmalloc size in MBytes. Use "vmalloc=size" to change it.

config HI3716MV430_FPGA
	bool "Enable HI3716MV430 Fpga config"
	default n if ARCH_HI3716MV430

endmenu
endif
```

## drivers/hisilicon/Kconfig.ca
```kconfig
menuconfig SUPPORT_CA
	bool "Support CA"
	default n
	help
	  If support ca, user privileges will be limit.
	  select y, support ca, otherwise not support ca.

config CA_SUPPORT_ADVCA
	bool "Support advca"
	depends on SUPPORT_CA
	select CA_NET_CONFIG
	select CA_FILE_AUTHORITY
	default n
	help
	  support advca, which is the real CA.

config CA_WARKUP_CHECK
	bool "Support CA wakeup ddr check"
	depends on SUPPORT_CA
	default n
	help
	  support ca suspend get hash value, and wakeup check ddr.

config CA_FILE_AUTHORITY
	bool
	default n
	help
	  support advca file authority.

config CA_NET_CONFIG
	bool
	default n
	help
	  support advca net config.

config CA_WAKEUP_CHECK_WHOLE
	bool "Support wakeup ddr check of whole area"
	default n
	help
	  support wakeup ddr check of the whole area. Otherwise, check the kernel and ko area
```

## drivers/hisilicon/devfreq/Kconfig
```kconfig
config DEVFREQ_GOV_GPU_ONDEMAND
	tristate "DEVFREQ_GOV_GPU_ONDEMAND"
	help
	  This driver provides support for the governor to do DVFS

config DEVFREQ_GOV_MIDGARD_ONDEMAND
	tristate "DEVFREQ_GOV_MIDGARD_ONDEMAND"
	help
	  This driver provides support for the governor to do DVFS
```

## drivers/hisilicon/securec/Kconfig
```kconfig
config KERNEL_LIBHWSECUREC
	bool "HW NEW secure c function library"
	default y
	help 
		this is a secure function for kernel
```

## drivers/hisilicon/soc/hi3716mv430/Kconfig
```kconfig
config CPU_IDLE_HI3716MV430
	bool "CPU Idle Driver for Hisilicon Hi3716mv430 processors"
	depends on ARCH_HI3716MV430
	help
	  Select this to enable cpuidle on Hi3716mv430 processors.
```
